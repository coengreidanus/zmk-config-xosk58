// #include "nordic/nrf52840_qiaa.dtsi" // Notice that the main dtsi files are included in the overlay.
#include "xosk58.overlay"
&kscan0 {
    input-gpios
        // List all 18 GPIO pins for the left side in key order
        // top row (5 keys)
        = <&gpio0 29 (GPIO_ACTIVE_HIGH | GPIO_PULL_DOWN)>
		, <&gpio0 8 (GPIO_ACTIVE_HIGH | GPIO_PULL_DOWN)>
		, <&gpio0 31 (GPIO_ACTIVE_HIGH | GPIO_PULL_DOWN)>
		, <&gpio0 17 (GPIO_ACTIVE_HIGH | GPIO_PULL_DOWN)>
		, <&gpio0 20 (GPIO_ACTIVE_HIGH | GPIO_PULL_DOWN)>
		
        
        // middle row (5 keys)
        , <&gpio1 1 (GPIO_ACTIVE_HIGH | GPIO_PULL_DOWN)>
        , <&gpio1 0 (GPIO_ACTIVE_HIGH | GPIO_PULL_DOWN)>
		, <&gpio0 24 (GPIO_ACTIVE_HIGH | GPIO_PULL_DOWN)>
		, <&gpio0 22 (GPIO_ACTIVE_HIGH | GPIO_PULL_DOWN)>
		, <&gpio0 2 (GPIO_ACTIVE_HIGH | GPIO_PULL_DOWN)>
		

        // bottom row (5 keys)
        , <&gpio0 9 (GPIO_ACTIVE_HIGH | GPIO_PULL_DOWN)>
        , <&gpio1 15 (GPIO_ACTIVE_HIGH | GPIO_PULL_DOWN)>
		, <&gpio1 6 (GPIO_ACTIVE_HIGH | GPIO_PULL_DOWN)>
		, <&gpio1 4 (GPIO_ACTIVE_HIGH | GPIO_PULL_DOWN)>
		, <&gpio0 11 (GPIO_ACTIVE_HIGH | GPIO_PULL_DOWN)>

        // thumb (3 keys)
        , <&gpio0 10 (GPIO_ACTIVE_HIGH | GPIO_PULL_DOWN)>
        , <&gpio1 11 (GPIO_ACTIVE_HIGH | GPIO_PULL_DOWN)> 
        , <&gpio1 13 (GPIO_ACTIVE_HIGH | GPIO_PULL_DOWN)>
        ;
};
