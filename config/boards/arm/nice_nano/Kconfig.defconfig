## config/boards/arm/nice_nano/Kconfig.defconfig
```kconfig
# Copyright (c) 2021 The ZMK Contributors
# SPDX-License-Identifier: MIT

if BOARD_XOSK || BOARD_XOSK_V2

config BOARD
    default "xosk"

if USB_DEVICE_STACK

config USB_NRFX
    default y

endif # USB_DEVICE_STACK

config BT_CTLR
    default BT

endif # BOARD_XOSK || BOARD_XOSK_V2
```

## config/boards/arm/xosk/Kconfig.board
```kconfig
# nice!nano board configuration

# Copyright (c) 2020 Pete Johanson
# SPDX-License-Identifier: MIT

config BOARD_XOSK
    bool "xosk"
    depends on SOC_NRF52840_QIAA

config BOARD_XOSK_V2
    bool "xoskv2"
    depends on SOC_NRF52840_QIAA
```

## config/boards/shields/xosk58/Kconfig.defconfig
```kconfig
if SHIELD_XOSK58_LEFT

config ZMK_KEYBOARD_NAME
    default "XOSK58"

config ZMK_SPLIT_ROLE_CENTRAL
    default y

endif

if SHIELD_XOSK58_LEFT || SHIELD_XOSK58_RIGHT

config ZMK_SPLIT
    default y

config ZMK_BLE
    default y

CONFIG_BT_CTLR_TX_PWR_PLUS_8=y

endif
```

## config/boards/shields/xosk58/Kconfig.shield
```kconfig
# Copyright (c) 2020 Pete Johanson
# SPDX-License-Identifier: MIT

config SHIELD_XOSK58_LEFT
    def_bool $(shields_list_contains, xosk58_left)

config SHIELD_XOSK58_RIGHT
    def_bool $(shields_list_contains, xosk58_right)
```
